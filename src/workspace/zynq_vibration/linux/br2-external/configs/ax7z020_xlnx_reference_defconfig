## src/workspace/zynq_vibration/linux/br2-external/configs/ax7z020_xlnx_reference_defconfig
```kconfig
BR2_arm=y
BR2_cortex_a9=y
BR2_ARM_ENABLE_NEON=y
BR2_ARM_ENABLE_VFP=y
BR2_ARM_EABIHF=y
BR2_TOOLCHAIN_EXTERNAL=y
BR2_TOOLCHAIN_EXTERNAL_BOOTLIN=y
BR2_TOOLCHAIN_EXTERNAL_BOOTLIN_ARMV7_EABIHF_GLIBC_STABLE=y
BR2_DOWNLOAD_FORCE_CHECK_HASHES=y
BR2_GLOBAL_PATCH_DIR="board/xilinx/patches"
BR2_REPRODUCIBLE=y
BR2_TARGET_GENERIC_HOSTNAME="ax7z020-vibration"
BR2_TARGET_GENERIC_ISSUE="AX7Z020 offline analysis - serial platform bring-up"
BR2_INIT_BUSYBOX=y
BR2_ROOTFS_DEVICE_CREATION_DYNAMIC_MDEV=y
BR2_TARGET_GENERIC_GETTY_PORT="ttyPS0"
BR2_TARGET_GENERIC_GETTY_BAUDRATE_115200=y
BR2_ROOTFS_OVERLAY="$(BR2_EXTERNAL_AX7Z020_PATH)/board/ax7z020/rootfs-overlay"
BR2_ROOTFS_POST_BUILD_SCRIPT="$(BR2_EXTERNAL_AX7Z020_PATH)/board/ax7z020/post-build.sh"
BR2_ROOTFS_POST_IMAGE_SCRIPT="$(BR2_EXTERNAL_AX7Z020_PATH)/board/ax7z020/post-image.sh"
BR2_LINUX_KERNEL=y
BR2_LINUX_KERNEL_CUSTOM_TARBALL=y
BR2_LINUX_KERNEL_CUSTOM_TARBALL_LOCATION="$(call github,Xilinx,linux-xlnx,xlnx_rebase_v6.6_LTS_merge_6.6.70)/xlnx_rebase_v6.6_LTS_merge_6.6.70.tar.gz"
BR2_LINUX_KERNEL_DEFCONFIG="xilinx_zynq"
BR2_LINUX_KERNEL_CONFIG_FRAGMENT_FILES="$(BR2_EXTERNAL_AX7Z020_PATH)/board/ax7z020/linux.fragment"
BR2_LINUX_KERNEL_ZIMAGE=y
BR2_LINUX_KERNEL_DTS_SUPPORT=y
BR2_LINUX_KERNEL_CUSTOM_DTS_PATH="$(BR2_EXTERNAL_AX7Z020_PATH)/board/ax7z020/dts/linux/zynq-ax7z020.dts $(BR2_EXTERNAL_AX7Z020_PATH)/board/ax7z020/dts/ax7z020-common.dtsi"
BR2_LINUX_KERNEL_NEEDS_HOST_OPENSSL=y
BR2_TARGET_ROOTFS_CPIO=y
BR2_TARGET_ROOTFS_CPIO_GZIP=y
# BR2_TARGET_ROOTFS_TAR is not set
BR2_TARGET_UBOOT=y
BR2_TARGET_UBOOT_BUILD_SYSTEM_KCONFIG=y
BR2_TARGET_UBOOT_CUSTOM_TARBALL=y
BR2_TARGET_UBOOT_CUSTOM_TARBALL_LOCATION="$(call github,Xilinx,u-boot-xlnx,xlnx_rebase_v2024.01_2024.2)/xlnx_rebase_v2024.01_2024.2.tar.gz"
BR2_TARGET_UBOOT_BOARD_DEFCONFIG="xilinx_zynq_virt"
BR2_TARGET_UBOOT_CONFIG_FRAGMENT_FILES="$(BR2_EXTERNAL_AX7Z020_PATH)/board/ax7z020/uboot.fragment"
BR2_TARGET_UBOOT_CUSTOM_DTS_PATH="$(BR2_EXTERNAL_AX7Z020_PATH)/board/ax7z020/dts/uboot/zynq-ax7z020.dts $(BR2_EXTERNAL_AX7Z020_PATH)/board/ax7z020/dts/ax7z020-common.dtsi"
BR2_TARGET_UBOOT_DEFAULT_ENV_FILE="$(BR2_EXTERNAL_AX7Z020_PATH)/board/ax7z020/uboot.env"
BR2_TARGET_UBOOT_CUSTOM_MAKEOPTS="DEVICE_TREE=zynq-ax7z020"
BR2_TARGET_UBOOT_NEEDS_DTC=y
BR2_TARGET_UBOOT_NEEDS_OPENSSL=y
BR2_TARGET_UBOOT_NEEDS_GNUTLS=y
BR2_TARGET_UBOOT_FORMAT_ELF=y
BR2_TARGET_UBOOT_FORMAT_REMAKE_ELF=y
BR2_TARGET_UBOOT_FORMAT_BIN=y
# BR2_TARGET_UBOOT_SPL is not set
BR2_PACKAGE_HOST_UBOOT_TOOLS=y
BR2_PACKAGE_HOST_UBOOT_TOOLS_FIT_SUPPORT=y
BR2_PACKAGE_USBUTILS=y
BR2_PACKAGE_EVTEST=y
BR2_PACKAGE_BUSYBOX_CONFIG_FRAGMENT_FILES="$(BR2_EXTERNAL_AX7Z020_PATH)/board/ax7z020/busybox.fragment"
BR2_PACKAGE_VIBRATION_OFFLINE=y
```

## src/workspace/zynq_vibration/linux/br2-external/package/qt-ax7zfb/Config.in
```kconfig
config BR2_PACKAGE_QT_AX7ZFB
	bool "Optional AX7Z020 two-page Qt QPA plugin"
	depends on BR2_PACKAGE_QT5BASE_GUI
	depends on BR2_PACKAGE_QT5BASE_LINUXFB
	depends on BR2_AX7Z020_DISPLAY_PLATFORM
	help
	  Build an additional ax7zfb platform plugin for the pinned Qt build.
	  The original linuxfb plugin is unchanged. Runtime use is explicit via
	  QT_QPA_PLATFORM=ax7zfb:fb=/dev/fb0. This requires the reviewed fixed
	  codex-ax7z020-fb driver and will fail clearly on other hardware.
```

## src/workspace/zynq_vibration_continuous_v4/hardware/combined/linux/Kconfig
```kconfig
config AX7Z020_CAPTURE
	bool "AX7Z020 combined MRG1 finite capture"
	depends on ARCH_ZYNQ && OF && HAS_DMA
	help
	  Exclusive misc device for the MRG1 capture producer and its simple S2MM
	  DMA. Do not create a separate DMAengine device for these resources.
```

## src/workspace/zynq_vibration_continuous_v4/hardware/combined/linux/sg/Kconfig
```kconfig
config AX7Z020_CAPTURE_SG
	bool "AX7Z020 combined finite SG capture with committed preview"
	depends on ARCH_ZYNQ && OF && HAS_DMA && !AX7Z020_CAPTURE
	select CRC32
	help
	  Preposts a complete finite SG chain. Only validated BD.Complete data is
	  copied to preview callers. The simple-DMA hardware is explicitly refused.
```

## src/workspace/zynq_vibration_continuous_v4/linux/br2-external/Config.in
```kconfig
menu "AX7Z020 offline vibration software"
source "$BR2_EXTERNAL_AX7Z020_PATH/package/vibration-offline/Config.in"
source "$BR2_EXTERNAL_AX7Z020_PATH/package/ax7z020-display-tools/Config.in"
source "$BR2_EXTERNAL_AX7Z020_PATH/package/qt-ax7zfb/Config.in"
config BR2_AX7Z020_DISPLAY_PLATFORM
	bool "Build the fixed AX7Z020 PS+display platform"
	depends on BR2_LINUX_KERNEL
	select BR2_PACKAGE_AX7Z020_DISPLAY_TOOLS
	help
	  Requires the matching PS+display XSA/bitstream and its ps7_init.
	  This platform cannot use the PS-only hardware image.
endmenu
```

## workspace/zynq_vibration/hardware/display/driver/Kconfig
```kconfig
config FB_CODEX_AX7Z020
	bool "AX7Z020 fixed 720p VDMA framebuffer"
	depends on FB && OF && ARCH_ZYNQ && DMA_CMA
	depends on !OF_OVERLAY && !SUSPEND && !HIBERNATION
	select FB_SYS_FILLRECT
	select FB_SYS_COPYAREA
	select FB_SYS_IMAGEBLIT
	select FB_SYS_FOPS
	help
	  Fixed built-in scanout driver for the project's AX7Z020 PS+display
	  hardware. Owns its VDMA, VTC and status GPIO together. No runtime
	  device removal, device-tree overlays or PL reconfiguration is supported.
	  System suspend/hibernation are unsupported in v1; ordinary CPU idle
	  remains available. These unsupported configurations disable selection.
	  Select the display kernel profile, including 64 MiB CMA, and use the
	  matching display XSA/FSBL. The PS-only image does not use this driver.
```

## workspace/zynq_vibration/linux/br2-external/configs/ax7z020_initramfs_defconfig
```kconfig
BR2_arm=y
BR2_cortex_a9=y
BR2_ARM_ENABLE_NEON=y
BR2_ARM_ENABLE_VFP=y
BR2_ARM_EABIHF=y
BR2_TOOLCHAIN_EXTERNAL=y
BR2_TOOLCHAIN_EXTERNAL_BOOTLIN=y
BR2_TOOLCHAIN_EXTERNAL_BOOTLIN_ARMV7_EABIHF_GLIBC_STABLE=y
BR2_DOWNLOAD_FORCE_CHECK_HASHES=y
BR2_GLOBAL_PATCH_DIR="board/xilinx/patches $(BR2_EXTERNAL_AX7Z020_PATH)/patches"
BR2_GNU_MIRROR="https://mirrors.tuna.tsinghua.edu.cn/gnu"
BR2_REPRODUCIBLE=y
BR2_TARGET_GENERIC_HOSTNAME="ax7z020-vibration"
BR2_TARGET_GENERIC_ISSUE="AX7Z020 offline analysis - serial platform bring-up"
BR2_INIT_BUSYBOX=y
BR2_ROOTFS_DEVICE_CREATION_DYNAMIC_MDEV=y
BR2_ROOTFS_DEVICE_TABLE="system/device_table.txt $(BR2_EXTERNAL_AX7Z020_PATH)/board/ax7z020/bootstrap_devices.txt"
BR2_TARGET_GENERIC_GETTY_PORT="ttyPS0"
BR2_TARGET_GENERIC_GETTY_BAUDRATE_115200=y
BR2_ROOTFS_OVERLAY="$(BR2_EXTERNAL_AX7Z020_PATH)/board/ax7z020/rootfs-overlay"
BR2_ROOTFS_POST_BUILD_SCRIPT="$(BR2_EXTERNAL_AX7Z020_PATH)/board/ax7z020/post-build.sh"
BR2_ROOTFS_POST_IMAGE_SCRIPT="$(BR2_EXTERNAL_AX7Z020_PATH)/board/ax7z020/post-image.sh"
BR2_LINUX_KERNEL=y
BR2_LINUX_KERNEL_CUSTOM_TARBALL=y
BR2_LINUX_KERNEL_CUSTOM_TARBALL_LOCATION="https://mirrors.tuna.tsinghua.edu.cn/kernel/v6.x/linux-6.6.70.tar.xz"
BR2_LINUX_KERNEL_USE_CUSTOM_CONFIG=y
BR2_LINUX_KERNEL_CUSTOM_CONFIG_FILE="$(BR2_EXTERNAL_AX7Z020_PATH)/board/ax7z020/linux.config"
BR2_LINUX_KERNEL_CONFIG_FRAGMENT_FILES="$(BR2_EXTERNAL_AX7Z020_PATH)/board/ax7z020/linux.fragment"
BR2_LINUX_KERNEL_ZIMAGE=y
BR2_LINUX_KERNEL_DTS_SUPPORT=y
BR2_LINUX_KERNEL_CUSTOM_DTS_PATH="$(BR2_EXTERNAL_AX7Z020_PATH)/board/ax7z020/dts/linux/zynq-ax7z020.dts $(BR2_EXTERNAL_AX7Z020_PATH)/board/ax7z020/dts/ax7z020-common.dtsi"
BR2_LINUX_KERNEL_NEEDS_HOST_OPENSSL=y
BR2_TARGET_ROOTFS_CPIO=y
BR2_TARGET_ROOTFS_CPIO_GZIP=y
# BR2_TARGET_ROOTFS_TAR is not set
BR2_TARGET_UBOOT=y
BR2_TARGET_UBOOT_BUILD_SYSTEM_KCONFIG=y
BR2_TARGET_UBOOT_CUSTOM_TARBALL=y
BR2_TARGET_UBOOT_CUSTOM_TARBALL_LOCATION="$(call github,Xilinx,u-boot-xlnx,xlnx_rebase_v2024.01_2024.2)/xlnx_rebase_v2024.01_2024.2.tar.gz"
BR2_TARGET_UBOOT_BOARD_DEFCONFIG="xilinx_zynq_virt"
BR2_TARGET_UBOOT_CONFIG_FRAGMENT_FILES="$(BR2_EXTERNAL_AX7Z020_PATH)/board/ax7z020/uboot.fragment"
BR2_TARGET_UBOOT_CUSTOM_DTS_PATH="$(BR2_EXTERNAL_AX7Z020_PATH)/board/ax7z020/dts/uboot/zynq-ax7z020.dts $(BR2_EXTERNAL_AX7Z020_PATH)/board/ax7z020/dts/ax7z020-common.dtsi"
# Native U-Boot text environment uses cpp/awk, avoiding a whole host Vim for xxd.
BR2_TARGET_UBOOT_CUSTOM_MAKEOPTS="DEVICE_TREE=zynq-ax7z020"
BR2_TARGET_UBOOT_NEEDS_DTC=y
BR2_TARGET_UBOOT_NEEDS_OPENSSL=y
BR2_TARGET_UBOOT_NEEDS_GNUTLS=y
BR2_TARGET_UBOOT_FORMAT_ELF=y
BR2_TARGET_UBOOT_FORMAT_REMAKE_ELF=y
BR2_TARGET_UBOOT_FORMAT_BIN=y
# BR2_TARGET_UBOOT_SPL is not set
# Raw bootz + cpio.gz needs no second host-only U-Boot source tree.
# BR2_PACKAGE_HOST_UBOOT_TOOLS is not set
BR2_PACKAGE_USBUTILS=y
BR2_PACKAGE_EVTEST=y
BR2_PACKAGE_BUSYBOX_CONFIG_FRAGMENT_FILES="$(BR2_EXTERNAL_AX7Z020_PATH)/board/ax7z020/busybox.fragment"
BR2_PACKAGE_VIBRATION_OFFLINE=y
```

## workspace/zynq_vibration_continuous_v4/linux/br2-external/package/vibration-offline/Config.in
```kconfig
config BR2_PACKAGE_VIBRATION_OFFLINE
	bool "vibration offline analyzer"
	depends on BR2_INSTALL_LIBSTDCPP
	depends on BR2_TOOLCHAIN_GCC_AT_LEAST_8
	help
	  Build the project's C++17 CAPDDR2 parser, FFT and evidence CLI.
	  This package does not operate acquisition hardware.

if BR2_PACKAGE_VIBRATION_OFFLINE
config BR2_PACKAGE_VIBRATION_OFFLINE_GUI
	bool "Qt Widgets interface"
	depends on BR2_PACKAGE_QT5BASE_WIDGETS
	help
	  Build the software-rendered GUI. A working display driver and
	  framebuffer must still be supplied by the board's PL design.
endif
```
