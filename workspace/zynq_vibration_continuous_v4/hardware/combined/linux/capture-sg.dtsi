/* SG-capable XSA only. No second DMAengine/UIO provider may own these ranges. */
/ {
	capture_clk50: capture-clock {
		compatible = "fixed-clock";
		#clock-cells = <0>;
		clock-frequency = <50000000>;
	};
};
&amba {
	ax7z020_capture: capture@43c10000 {
		compatible = "codex,ax7z020-capture-sg1";
		reg = <0x43c10000 0x10000>, <0x40400000 0x10000>;
		reg-names = "capture", "s2mm";
		interrupt-parent = <&intc>;
		interrupts = <0 30 4>;
		clocks = <&capture_clk50>;
		clock-names = "axi";
		codex,sg-length-width = <26>;
		codex,dma-address-width = <32>;
		codex,sg-control-status-stream = <0>;
		codex,preview-period-us = <40000>;
		status = "okay";
	};
};
